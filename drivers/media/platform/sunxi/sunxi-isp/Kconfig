## drivers/media/platform/sunxi/sunxi-isp/Kconfig
```kconfig
# SPDX-License-Identifier: GPL-2.0-only
config VIDEO_SUNXI_ISP
	tristate "Allwinner Image Signal Processor (ISP) Driver"
	depends on ARCH_SUNXI || COMPILE_TEST
	depends on PM && COMMON_CLK && VIDEO_DEV && VIDEO_V4L2
	depends on HAS_DMA
	select REGMAP_MMIO
	select MEDIA_CONTROLLER
	select VIDEOBUF2_DMA_CONTIG
	select V4L2_MEM2MEM_DEV
	help
	   Support for the Allwinner Image Signal Processor (ISP).
```
